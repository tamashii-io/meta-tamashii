## conf/layer.conf
```bitbake
# We have a conf and classes directory, add to BBPATH
BBPATH .= ":${LAYERDIR}"

# We have recipes-* directories, add to BBFILES
BBFILES += "${LAYERDIR}/recipes-*/*/*.bb \
            ${LAYERDIR}/recipes-*/*/*.bbappend"

BBFILE_COLLECTIONS += "tamashii"
BBFILE_PATTERN_tamashii = "^${LAYERDIR}/"
BBFILE_PRIORITY_tamashii = "6"

LAYERDEPENDS_tamashii = "rubygems"

LAYERSERIES_COMPAT_tamashii = "thud"

DISTRO_FEATURES_append = " wifi"

IMAGE_INSTALL_append = " iw wpa-supplicant linux-firmware-bcm43430 packagegroup-base"
```
